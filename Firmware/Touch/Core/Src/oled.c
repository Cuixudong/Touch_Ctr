#include "oled.h"

//常用ASCII表
//偏移量32
//ASCII字符集: !"#$%&'()*+,-./0123456789:;<=>?@ABCDEFGHIJKLMNOPQRSTUVWXYZ[\]^_`abcdefghijklmnopqrstuvwxyz{|}~
//PC2LCD2002取模方式设置：阴码+逐列式+顺向+C51格式
//12*12 ASCII字符集点阵
const uint8_t asc2_1206[95][12]= {
    {0x00,0x00,0x00,0x00,0x00,0x00,0x00,0x00,0x00,0x00,0x00,0x00},/*" ",0*/
    {0x00,0x00,0x00,0x00,0x3F,0x40,0x00,0x00,0x00,0x00,0x00,0x00},/*"!",1*/
    {0x00,0x00,0x30,0x00,0x40,0x00,0x30,0x00,0x40,0x00,0x00,0x00},/*""",2*/
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    {0x40,0x00,0x80,0x00,0x40,0x00,0x20,0x00,0x20,0x00,0x40,0x00},/*"~",94*/
};
//16*16 ASCII字符集点阵
const uint8_t asc2_1608[95][16]=
{
    {0x00,0x00,0x00,0x00,0x00,0x00,0x00,0x00,0x00,0x00,0x00,0x00,0x00,0x00,0x00,0x00},/*" ",0*/
    {0x00,0x00,0x00,0x00,0x00,0x00,0x1F,0xCC,0x00,0x0C,0x00,0x00,0x00,0x00,0x00,0x00},/*"!",1*/
    {0x00,0x00,0x08,0x00,0x30,0x00,0x60,0x00,0x08,0x00,0x30,0x00,0x60,0x00,0x00,0x00},/*""",2*/
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    {0x00,0x00,0x60,0x00,0x80,0x00,0x80,0x00,0x40,0x00,0x40,0x00,0x20,0x00,0x20,0x00},/*"~",94*/
};

#include "spi.h"

//OLED显存
uint8_t OLED_GRAM[OLED_W * OLED_PAGE_H][OLED_PAGE_V * OLED_H / 8];
OLED_Display_Ctr oled_ctr;

const uint8_t oled_mem_calc_arr[7]={0x01,0x03,0x07,0x0F,0x1F,0x3F,0x7F,};

//更新显存到LCD
void OLED_Refresh_Gram(void)
{
    uint16_t i,n;
    uint8_t cur_data;
    
    //OLED_CUR_POS_Y = OLED_CUR_POS_Y % ((OLED_PAGE_V - 1) * OLED_H);
    for(i=0; i<8; i++)
    {
        OLED_WR_Byte (0xb0+i,OLED_CMD);    //设置页地址（0~7）
        OLED_WR_Byte (0x00,OLED_CMD);      //设置显示位置—列低地址    //1.3寸oled 0x02
        OLED_WR_Byte (0x10,OLED_CMD);      //设置显示位置—列高地址
        for(n=0; n<OLED_W; n++)
        {
            if(OLED_MOVE_DIR == 0)
            {
                if((OLED_CUR_POS_Y % 8) == 0)
                {
                    OLED_WR_Byte(OLED_GRAM[(n + OLED_CUR_POS_X) % (OLED_W * OLED_PAGE_H)][(i + OLED_CUR_POS_Y / 8) % (OLED_PAGE_V * 8)],OLED_DATA);
                }
                else
                {
                    cur_data = (((OLED_GRAM[(n + OLED_CUR_POS_X) % (OLED_W * OLED_PAGE_H)][(i + OLED_CUR_POS_Y / 8 + 1) % (OLED_PAGE_V * 8)] << 8) | \
                    OLED_GRAM[(n + OLED_CUR_POS_X) % (OLED_W * OLED_PAGE_H)][(i + OLED_CUR_POS_Y / 8) % (OLED_PAGE_V * 8)]) >> (OLED_CUR_POS_Y % 8)) & 0xFF;
//cur_data  = OLED_GRAM[n][i + OLED_CUR_POS_Y / 8] >> (OLED_CUR_POS_Y % 8) + (OLED_GRAM[n][i + OLED_CUR_POS_Y / 8 + 1] & oled_mem_calc_arr[OLED_CUR_POS_Y % 8]) << (OLED_CUR_POS_Y % 8);
                    OLED_WR_Byte(cur_data,OLED_DATA);
                }
            }
            else
            {
                OLED_WR_Byte(OLED_GRAM[(n + OLED_CUR_POS_Y) % (OLED_W * OLED_PAGE_H)][i + ((OLED_CUR_POS_Y + n) / (OLED_W * OLED_PAGE_H)) * 8],OLED_DATA);
            }
        }
    }
}

//SPI 速度设置函数
void SPI2_SetSpeed(uint8_t SpeedSet)
{
    assert_param(IS_SPI_BAUDRATE_PRESCALER(SpeedSet));//判断有效性
    __HAL_SPI_DISABLE(&hspi2);              //关闭SPI
    hspi2.Instance->CR1&=0XFFC7;            //位3-5清零，用来设置波特率
    hspi2.Instance->CR1|=SpeedSet;          //设置SPI速度
    __HAL_SPI_ENABLE(&hspi2);               //使能SPI
}

//SPIx 读写一个字节
uint8_t SPI2_ReadWriteByte(uint8_t TxData)
{
    uint8_t  Rxdata;
    HAL_SPI_TransmitReceive(&hspi2,&TxData,&Rxdata,1, 1000);
    return Rxdata;  //返回收到的数据
}

//向SSD1306写入一个字节。
//dat:要写入的数据/命令
//cmd:数据/命令标志 0,表示命令;1,表示数据;
void OLED_WR_Byte(uint8_t dat,uint8_t cmd)
{
    uint8_t i;
    if(cmd) //写命令
    {
        OLED_DC_H;
    }
    else
    {
        OLED_DC_L;
    }
    OLED_CS_L;
    #if (!USB_HW_SPI)
    for(i=0;i<8;i++)
    {
        OLED_D0_L;
    
        if(dat&0x80)
            OLED_D1_H;
        else 
            OLED_D1_L;
    
        OLED_D0_H;
    
        dat<<=1;
    }
    #else
    i = dat;
    HAL_SPI_Transmit(&hspi2,&i,1,0xFF);
    #endif
    OLED_CS_H;
    OLED_DC_H;
}

//开启OLED显示
void OLED_Display_On(void)
{
    OLED_WR_Byte(0X8D,OLED_CMD);  //SET DCDC命令
    OLED_WR_Byte(0X14,OLED_CMD);  //DCDC ON
    OLED_WR_Byte(0XAF,OLED_CMD);  //DISPLAY ON
}
//关闭OLED显示
void OLED_Display_Off(void)
{
    OLED_WR_Byte(0X8D,OLED_CMD);  //SET DCDC命令
    OLED_WR_Byte(0X10,OLED_CMD);  //DCDC OFF
    OLED_WR_Byte(0XAE,OLED_CMD);  //DISPLAY OFF
}

void OLED_SetDir(uint8_t para)
{
    if (para == 1)
    {
        OLED_WR_Byte(0xA0,OLED_CMD);/* A0 ：列地址0映射到SEG0; A1 ：列地址127映射到SEG0 */
        OLED_WR_Byte(0xC8,OLED_CMD);/* C0 ：正常扫描,从COM0到COM63;  C8 : 反向扫描, 从 COM63至 COM0 */
    }
    else if (para == 0)
    {
        OLED_WR_Byte(0xA1,OLED_CMD);/* A0 ：列地址0映射到SEG0; A1 ：列地址127映射到SEG0 */
        OLED_WR_Byte(0xC0,OLED_CMD);/* C0 ：正常扫描,从COM0到COM63;  C8 : 反向扫描, 从 COM63至 COM0 */
    }
    else if (para == 2)
    {
        OLED_WR_Byte(0xA0,OLED_CMD);/* A0 ：列地址0映射到SEG0; A1 ：列地址127映射到SEG0 */
        OLED_WR_Byte(0xC0,OLED_CMD);/* C0 ：正常扫描,从COM0到COM63;  C8 : 反向扫描, 从 COM63至 COM0 */
    }
    else if (para == 3)
    {
        OLED_WR_Byte(0xA1,OLED_CMD);/* A0 ：列地址0映射到SEG0; A1 ：列地址127映射到SEG0 */
        OLED_WR_Byte(0xC8,OLED_CMD);/* C0 ：正常扫描,从COM0到COM63;  C8 : 反向扫描, 从 COM63至 COM0 */
    }
}

void OLED_SetContrast(uint8_t para)
{
    OLED_WR_Byte(0x81,OLED_CMD);    /* 设置对比度命令(双字节命令），第1个字节是命令，第2个字节是对比度参数0-255 */
    OLED_WR_Byte(para,OLED_CMD); /* 设置对比度参数,缺省CF */
}

//清屏函数,清完屏,整个屏幕是黑色的!和没点亮一样!!!
void OLED_Clear(uint8_t para)
{
    uint16_t i,n;
    for(i=0; i<OLED_PAGE_V * OLED_H / 8; i++)
    {
        for(n=0; n<OLED_W * OLED_PAGE_H; n++)
        {
            OLED_GRAM[n][i]=0X00;
        }
    }
    if(para)
    {
        OLED_Refresh_Gram();//更新显示
    }
}

//画点
//x:0~127
//y:0~63
//t:1 填充 0,清空
void OLED_DrawPoint(uint16_t x,uint16_t y,uint8_t p)
{
    uint16_t cur_x,cur_y;
    cur_x = x + OLED_OFFSET_X;
    cur_y = y + OLED_OFFSET_Y;
    if((cur_x > OLED_W * OLED_PAGE_H - 1)||cur_y > (OLED_PAGE_V * OLED_H - 1))return;//超出范围了.
    if(p)
        OLED_GRAM[cur_x][cur_y/8] |= 1 << (cur_y % 8);
    else
        OLED_GRAM[cur_x][cur_y/8] &= ~ (1 << (cur_y % 8));
}
//x1,y1,x2,y2 填充区域的对角坐标
//确保x1<=x2;y1<=y2 0<=x1<=127 0<=y1<=63
//dot:0,清空;1,填充
void OLED_Fill(uint16_t x1,uint16_t y1,uint16_t x2,uint16_t y2,uint8_t dot)
{
    uint16_t x,y;
    for(x=x1; x<x2; x++)
    {
        for(y=y1; y<y2; y++)
        {
            OLED_DrawPoint(x,y,dot);
        }
    }
}

//画线
//x1,y1:起点坐标
//x2,y2:终点坐标
void OLED_DrawLine(uint16_t x1, uint16_t y1, uint16_t x2, uint16_t y2,uint8_t dot)
{
    uint16_t t;
    int xerr=0,yerr=0,delta_x,delta_y,distance;
    int incx,incy,uRow,uCol;
    delta_x=x2-x1; //计算坐标增量
    delta_y=y2-y1;
    uRow=x1;
    uCol=y1;
    if(delta_x>0)incx=1; //设置单步方向
    else if(delta_x==0)incx=0;//垂直线
    else {
        incx=-1;
        delta_x=-delta_x;
    }
    if(delta_y>0)incy=1;
    else if(delta_y==0)incy=0;//水平线
    else {
        incy=-1;
        delta_y=-delta_y;
    }
    if( delta_x>delta_y)distance=delta_x; //选取基本增量坐标轴
    else distance=delta_y;
    for(t=0; t<=distance+1; t++ ) //画线输出
    {
        OLED_DrawPoint(uRow,uCol,dot);//画点
        xerr+=delta_x ;
        yerr+=delta_y ;
        if(xerr>distance)
        {
            xerr-=distance;
            uRow+=incx;
        }
        if(yerr>distance)
        {
            yerr-=distance;
            uCol+=incy;
        }
    }
}
//画矩形
//(x1,y1),(x2,y2):矩形的对角坐标
void OLED_DrawRectangle(uint16_t x1, uint16_t y1, uint16_t x2, uint16_t y2,uint8_t dot)
{
    OLED_DrawLine(x1,y1,x2,y1,dot);
    OLED_DrawLine(x1,y1,x1,y2,dot);
    OLED_DrawLine(x1,y2,x2,y2,dot);
    OLED_DrawLine(x2,y1,x2,y2,dot);
}
//在指定位置画一个指定大小的圆
//(x,y):中心点
//r    :半径
void OLED_Draw_Circle(uint16_t x0,uint16_t y0,uint16_t r,uint8_t dot)
{
    int a,b;
    int di;
    a=0;
    b=r;
    di=3-(r<<1);             //判断下个点位置的标志
    while(a<=b)
    {
        OLED_DrawPoint(x0+a,y0-b,dot);
        OLED_DrawPoint(x0+b,y0-a,dot);
        OLED_DrawPoint(x0+b,y0+a,dot);
        OLED_DrawPoint(x0+a,y0+b,dot);
        OLED_DrawPoint(x0-a,y0+b,dot);
        OLED_DrawPoint(x0-b,y0+a,dot);
        OLED_DrawPoint(x0-a,y0-b,dot);
        OLED_DrawPoint(x0-b,y0-a,dot);
        a++;
        //使用Bresenham算法画圆
        if(di<0)di +=4*a+6;
        else
        {
            di+=10+4*(a-b);
            b--;
        }
    }
}

//在指定位置显示一个字符,包括部分字符
//x:0~127
//y:0~63
//mode:0,反白显示;1,正常显示
//size:选择字体 12/16/24
void OLED_ShowChar(uint16_t x,uint16_t y,char chr,uint8_t size,uint8_t mode)
{
    uint16_t temp,t,t1;
    uint16_t y0=y;
    uint16_t csize=(size/8+((size%8)?1:0))*(size/2); //得到字体一个字符对应点阵集所占的字节数
    chr=chr-' ';//得到偏移后的值
    for(t=0; t<csize; t++)
    {
        if(size==12)temp=asc2_1206[chr][t]; //调用1608字体
        else if(size==16)temp=asc2_1608[chr][t];    //调用1608字体
        else return;    //没有的字库
        for(t1=0; t1<8; t1++)
        {
            if(temp&0x80)OLED_DrawPoint(x,y,mode);
            else OLED_DrawPoint(x,y,!mode);
            temp<<=1;
            y++;
            if((y-y0)==size)
            {
                y=y0;
                x++;
                break;
            }
        }
    }
}
//m^n函数
uint32_t mypow(uint8_t m,uint8_t n)
{
    uint32_t result=1;
    while(n--)result*=m;
    return result;
}
//显示2个数字
//x,y :起点坐标
//len :数字的位数
//size:字体大小
//mode:模式	0,填充模式;1,叠加模式
//num:数值(0~4294967295);
void OLED_ShowNum(uint16_t x,uint16_t y,uint32_t num,uint8_t len,uint8_t size,uint8_t mode)
{
    uint16_t t,temp;
    uint8_t enshow=0;
    for(t=0; t<len; t++)
    {
        temp=(num/mypow(10,len-t-1))%10;
        if(enshow==0&&t<(len-1))
        {
            if(temp==0)
            {
                OLED_ShowChar(x+(size/2)*t,y,' ',size,mode);
                continue;
            } else enshow=1;

        }
        OLED_ShowChar(x+(size/2)*t,y,temp+'0',size,mode);
    }
}
//显示字符串
//x,y:起点坐标
//size:字体大小
//*p:字符串起始地址
void OLED_ShowString(uint16_t x,uint16_t y,char *p,uint8_t size)
{
    while((*p<='~')&&(*p>=' '))//判断是不是非法字符!
    {
        if(x>(OLED_W * OLED_PAGE_H -(size/2))) {
            x=0;
            y+=size;
        }
        if(y>(OLED_H * OLED_PAGE_V -size)) {
            y=x=0;
            OLED_Clear(0);
        }
        OLED_ShowChar(x,y,*p,size,1);
        x+=size/2;
        p++;
    }

}
//初始化SSD1306
void OLED_Init(void)
{
    oled_ctr.height = OLED_H;
    oled_ctr.widget = OLED_W;
    oled_ctr.oled_cur_pos_x = 0;
    oled_ctr.oled_cur_pos_y = 0;
    oled_ctr.oled_offset_x = 0;
    oled_ctr.oled_offset_y = 0;
    oled_ctr.oled_page_h = OLED_PAGE_H;
    oled_ctr.oled_page_v = OLED_PAGE_V;
    oled_ctr.oled_move_dir = 0;
    
    //使用4线SPI 串口模式
    OLED_CS_H;
    OLED_DC_H;

    OLED_RST_L;
    HAL_Delay(100);
    OLED_RST_H;

    OLED_WR_Byte(0xAE,OLED_CMD); //关闭显示
    OLED_WR_Byte(0xD5,OLED_CMD); //设置时钟分频因子,震荡频率
    OLED_WR_Byte(80,OLED_CMD);   //[3:0],分频因子;[7:4],震荡频率
    OLED_WR_Byte(0xA8,OLED_CMD); //设置驱动路数
    OLED_WR_Byte(0X3F,OLED_CMD); //默认0X3F(1/64)
    OLED_WR_Byte(0xD3,OLED_CMD); //设置显示偏移
    OLED_WR_Byte(0X00,OLED_CMD); //默认为0

    OLED_WR_Byte(0x40,OLED_CMD); //设置显示开始行 [5:0],行数.

    OLED_WR_Byte(0x8D,OLED_CMD); //电荷泵设置
    OLED_WR_Byte(0x14,OLED_CMD); //bit2，开启/关闭
    OLED_WR_Byte(0x20,OLED_CMD); //设置内存地址模式
    OLED_WR_Byte(0x02,OLED_CMD); //[1:0],00，列地址模式;01，行地址模式;10,页地址模式;默认10;
    OLED_WR_Byte(0xA1,OLED_CMD); //段重定义设置,bit0:0,0->0;1,0->127;
    OLED_WR_Byte(0xC8,OLED_CMD); //设置COM扫描方向;bit3:0,普通模式;1,重定义模式 COM[N-1]->COM0;N:驱动路数
    OLED_WR_Byte(0xDA,OLED_CMD); //设置COM硬件引脚配置
    OLED_WR_Byte(0x12,OLED_CMD); //[5:4]配置

    OLED_WR_Byte(0x81,OLED_CMD); //对比度设置
    OLED_WR_Byte(0xEF,OLED_CMD); //1~255;默认0X7F (亮度设置,越大越亮)
    OLED_WR_Byte(0xD9,OLED_CMD); //设置预充电周期
    OLED_WR_Byte(0xf1,OLED_CMD); //[3:0],PHASE 1;[7:4],PHASE 2;
    OLED_WR_Byte(0xDB,OLED_CMD); //设置VCOMH 电压倍率
    OLED_WR_Byte(0x30,OLED_CMD); //[6:4] 000,0.65*vcc;001,0.77*vcc;011,0.83*vcc;

    OLED_WR_Byte(0xA4,OLED_CMD); //全局显示开启;bit0:1,开启;0,关闭;(白屏/黑屏)
    OLED_WR_Byte(0xA6,OLED_CMD); //设置显示方式;bit0:1,反相显示;0,正常显示
    OLED_WR_Byte(0xAF,OLED_CMD); //开启显示
    OLED_Clear(0);
}

//读点
//x:0~127
//y:0~63
uint8_t OLED_ReadPoint(uint16_t x,uint16_t y)
{
    uint16_t pos,bx,temp=0x00;
    //x = 127-x;
    y = 63-y;
    pos=y/8;
    bx=y%8;
    temp=1<<bx;
    if(temp&OLED_GRAM[x][pos]) return 1;
    return 0;
}


const char * my_text_tab = \
"穿过纷繁复杂的生物圈你来到我面前是否有一条无形碳链冥中把相连目光如水浸润\
每个细胞声音糖让拥了尽力量刻都在思念苏丹般容颜已进入核苷酸充斥着信息控制\
所蛋白质法逃避就算构成膜磷脂也可以轻易透对爱自由扩散不需要任何能和载体遗\
传代谢线粒没便失去叶绿新养料溶酶随时解切其实像氨基样俘虏内网加工高尔包裹\
又放弃为什么还那因希望们两脱分子畏互接紧密地肽键感葡萄件熟合并麦芽配氧必\
将美丽双螺旋";

const uint8_t my_text[][32]=
{
    /*穿过纷繁复杂的生物圈你来到我面前是否有一条无形碳链冥中把相连目光如水浸润每个细胞\
    声音糖让拥了尽力量刻都在思念苏丹I般容颜已进入核苷酸DNA充斥着信息控制所蛋白质法逃避\
    就算构成膜磷脂也可以轻易透对爱自由扩散不需要任何能和载体遗传代谢线粒没便失去叶绿新\
    养料溶酶随时解切其实像氨基样俘虏内网加工高尔包裹又放弃为什么还那因希望们两脱分子畏\
    互接紧密地肽键感葡萄件熟合并麦芽配氧必将美丽双螺旋*/
    0x08,0x00,0x30,0x02,0x22,0x62,0x2A,0xA4,0x32,0x24,0x22,0x28,0xA2,0x28,0x62,0x32,
    0x22,0x21,0x23,0xFE,0x32,0x20,0x2A,0x20,0x22,0x20,0x2A,0x20,0x30,0x20,0x00,0x00,/*"穿",0*/
    0x02,0x00,0x02,0x02,0x42,0x04,0x33,0xF8,0x00,0x04,0x10,0x02,0x12,0x02,0x11,0x82,
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    0x40,0x80,0x40,0x82,0x40,0x81,0x7F,0xFE,0x00,0x80,0x00,0x80,0x00,0x80,0x00,0x00,/*"丹",16*/
    //0x00,0x00,0x10,0x04,0x10,0x04,0x1F,0xFC,0x10,0x04,0x10,0x04,0x00,0x00,0x00,0x00,/*"I",17*/
    0x01,0x01,0x01,0x06,0x3F,0xF8,0x69,0x40,0xA7,0x32,0x21,0x01,0x3F,0xFE,0x00,0x01,
    0x05,0x01,0x79,0xC2,0x41,0x34,0x41,0x08,0x79,0x34,0x05,0xC2,0x04,0x01,0x00,0x00,/*"般",18*/
    0x08,0x20,0x30,0x20,0x22,0x40,0x24,0x7F,0x28,0xA2,0x21,0x22,0xA2,0x22,0x64,0x22,
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    0x09,0x11,0x1A,0x62,0x2D,0x94,0xC8,0x88,0x0C,0x94,0x1A,0xE2,0x09,0x01,0x00,0x00,/*"酸",26*/
    //0x10,0x04,0x1F,0xFC,0x10,0x04,0x10,0x04,0x10,0x04,0x08,0x08,0x07,0xF0,0x00,0x00,/*"D",27*/
    //0x10,0x04,0x1F,0xFC,0x0C,0x04,0x03,0x00,0x00,0xE0,0x10,0x18,0x1F,0xFC,0x10,0x00,/*"N",28*/
    //0x00,0x04,0x00,0x3C,0x03,0xC4,0x1C,0x40,0x07,0x40,0x00,0xE4,0x00,0x1C,0x00,0x04,/*"A",29*/
    0x20,0x00,0x20,0x01,0x21,0x01,0x23,0x02,0x25,0x0C,0x39,0xF0,0xA1,0x00,0x61,0x00,
    0x21,0x00,0x21,0xFE,0x25,0x01,0x23,0x01,0x21,0x81,0x20,0x0F,0x20,0x00,0x00,0x00,/*"充",30*/
    0x00,0x01,0x00,0x02,0x00,0x0C,0x3F,0xF0,0x22,0x00,0x22,0x00,0x22,0x00,0x22,0x40,
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    0xE4,0xF8,0x24,0x04,0x27,0xFE,0x24,0x22,0x24,0x22,0x27,0x22,0x20,0x02,0x00,0x00,/*"旋",32*/
};

const char* font1616_table =
{
    "蓝牙音箱版本号已连接断开等待中开关机请充电池压量低波形频谱显示静播放正常模式年月日星期上下午"
};

const unsigned char font_1616[46][32]= {
    {0x20,0x02,0x20,0x02,0x27,0xBE,0x20,0x22,0xF0,0x22,0x2F,0xBE,0x20,0x22,0x20,0xA2,0x2F,0x22,0x22,0x3E,0xF3,0x22,0x22,0xA2,0x22,0x3E,0x22,0x02,0x20,0x02,0x00,0x00},/*"蓝",0*/
    {0x00,0x00,0x00,0x04,0x43,0x04,0x4D,0x08,0x41,0x10,0x41,0x20,0x41,0x40,0x41,0x82,0x41,0x01,0x7F,0xFE,0x41,0x00,0x41,0x00,0x41,0x00,0x41,0x00,0x01,0x00,0x00,0x00},/*"牙",1*/
    {0x02,0x00,0x02,0x00,0x22,0x00,0x22,0xFF,0x2A,0x92,0x26,0x92,0xA2,0x92,0x62,0x92,0x22,0x92,0x26,0x92,0x2A,0x92,0x22,0xFF,0x22,0x00,0x02,0x00,0x02,0x00,0x00,0x00},/*"音",2*/
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    {0x00,0x40,0x02,0x40,0x04,0x40,0x18,0x40,0xF0,0x40,0x10,0x40,0x10,0x40,0x1F,0xFF,0x10,0x40,0x10,0x40,0x10,0x40,0x10,0x40,0x10,0x40,0x00,0x40,0x00,0x40,0x00,0x00},/*"午",45*/

};

//显示一个指定大小的汉字
//x,y :汉字的坐标
//font:汉字GBK码
//f_w:字宽
//f_h:字高
//mode:0,正常显示,1,叠加显示
void OLED_Show_Font(uint16_t x,uint16_t y,char *font,uint8_t f_w,uint8_t f_h,uint8_t mode)
{
    const char* font_table;
    uint16_t fontSeq;
    uint8_t temp,t,t1;
    uint16_t y0=y;
    uint8_t csize=(f_h/8+((f_h%8)?1:0))*f_w;//得到自由分辨字符所占的字节数

    if(f_w==16 && f_h==16)
    {
        if(OLED_MOVE_DEMO_EN)font_table = my_text_tab;
        else font_table = font1616_table;
    }
    else
        return;/*没有的字库*/
    for(fontSeq=0; fontSeq<strlen(font_table)/2; fontSeq++)/*计算font_table对应字库的数组下标*/
    {
        if(font_table[2*fontSeq]==font[0] && font_table[2*fontSeq+1]==font[1])
            break;
    }
    if(fontSeq >= strlen(font_table)/2) return;/*font_table中没有font该字*/

    for(t=0; t<csize; t++)
    {
        if(f_w==16 && f_h==16)
        {
            if(OLED_MOVE_DEMO_EN)temp = my_text[fontSeq][t];
            else temp = font_1616[fontSeq][t];
        }
        for(t1=0; t1<8; t1++)
        {
            if(temp&0x80)
                OLED_DrawPoint(x,y,mode);
            else 
                OLED_DrawPoint(x,y,!mode);
            temp<<=1;
            y++;
            if((y-y0)==f_h)
            {
                y=y0;
                x++;
                break;
            }
        }
    }
}

//在指定位置开始显示一个字符串
//支持自动换行
//(x,y):起始坐标
//width,height:区域
//str  :字符串
//f_w:字宽
//f_h:字高
//mode:0,非叠加方式;1,叠加方式
void OLED_Show_Str(uint16_t x,uint16_t y,char *str,uint8_t f_h,uint8_t mode)
{
    uint16_t x0=x;
    uint16_t y0=y;
    uint8_t bHz=0;      //字符或者中文
    while(*str!=0)      //数据未结束
    {
        if(!bHz)
        {
            if((unsigned char)(*str)>0x80)
            {
                bHz=1;//中文
            }
            else               //字符
            {
                if(x>(x0+OLED_W * OLED_PAGE_H - f_h / 2))//换行
                {
                    y+=f_h;
                    x=x0;
                }
                if(y>(y0+OLED_PAGE_V * OLED_H-f_h))break;//越界返回
                if(*str==13)//换行符号
                {
                    y+=f_h;
                    x=x0;
                    str++;
                }
                else OLED_ShowChar(x,y,*str,f_h,mode);//有效部分写入
                str++;
                x+=f_h/2; //字符,为全字的一半
            }
        }
        else//中文
        {
            bHz=0;//有汉字库
            if(x>(x0+OLED_W * OLED_PAGE_H -f_h))//换行
            {
                y+=f_h+2;//2为行间距
                x=x0;
            }
            if(y>(y0+OLED_PAGE_V * OLED_H-f_h))break;//越界返回
            OLED_Show_Font(x,y,str,f_h,f_h,mode); //显示这个汉字,空心显示
            str+=2;
            x+=f_h;//下一个汉字偏移
        }
    }
}
//在指定宽度的中间显示字符串
//如果字符长度超过了len,则用Show_Str显示
//len:指定要显示的宽度
void OLED_Show_Str_Mid(uint16_t x,uint16_t y,char *str,uint8_t f_h,uint8_t mode,uint16_t len)
{
    uint16_t strlenth=0;
    strlenth=strlen((char*)str);
    strlenth*=f_h/2;
    if(strlenth>len)OLED_Show_Str(x,y,str,f_h,mode);
    else
    {
        strlenth=(len-strlenth)/2;
        OLED_Show_Str(strlenth+x,y,str,f_h,mode);
    }
}

//10*16==宽*高  电量.bmp*13
const unsigned char bmp_battery[13][20]=
{
    {0x3F,0xFF,0x20,0x01,0x20,0x01,0xE0,0x01,0x80,0x01,0x80,0x01,0xE0,0x01,0x20,0x01,0x20,0x01,0x3F,0xFF},/*0格电量.BMP*/
    {0x3F,0xFF,0x20,0x03,0x20,0x03,0xE0,0x03,0x80,0x03,0x80,0x03,0xE0,0x03,0x20,0x03,0x20,0x03,0x3F,0xFF},/*1格电量.BMP*/
    {0x3F,0xFF,0x20,0x07,0x20,0x07,0xE0,0x07,0x80,0x07,0x80,0x07,0xE0,0x07,0x20,0x07,0x20,0x07,0x3F,0xFF},/*2格电量.BMP*/
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    {0x3F,0xFF,0x3F,0xFF,0x3F,0xFF,0xFF,0xFF,0x9F,0xFF,0x9F,0xFF,0xFF,0xFF,0x3F,0xFF,0x3F,0xFF,0x3F,0xFF},/*12格电量.BMP*/
};

//显示图片
//x,y:起点坐标
//p_w:图片宽（单位像素）
//p_h:图片高（单位像素）
//*p:图片起始地址
void OLED_Show_Picture(uint16_t x,uint16_t y,uint8_t *p,uint16_t p_w,uint16_t p_h)
{
    uint8_t temp, i, col, row;
    uint8_t y0 = y;
    uint8_t high,width;
    uint8_t exp_col_bytes,act_col_bytes;
    width = p_w;
    if(x + p_w > OLED_W)
    {
        width = OLED_W - p_w;//实际显示宽度
    }
    high = p_h;
    if(y + p_h > OLED_H)
    {
        high = OLED_H - p_h;//实际显示高度
    }
    exp_col_bytes = (p_h / 8 + ((p_h % 8) ? 1 : 0));//显示一列的字节数
    act_col_bytes = (high / 8 + ((high % 8) ? 1 : 0));//实际显示一列的字节数

    for(row = 0; row < width; row++) //列++
    {
        for(col = 0; col < act_col_bytes; col++) //显示一列
        {
            temp = p[col + row * exp_col_bytes];
            for(i=0; i<8; i++)
            {
                if(temp&0x80)
                    OLED_DrawPoint(x,y,1);
                else 
                    OLED_DrawPoint(x,y,0);
                temp <<= 1;
                y++;
                if((y - y0) == high)
                {
                    y = y0;
                    x++;
                    break;
                }
            }
        }
    }
}

const char * articl[46] =
{
    "穿过纷繁复杂的生物圈",
    "你来到我的面前",
    "是否",
    "有一条无形的碳链",
    "冥冥中把你我相连",
    "你的目光如水",
    "浸润我的每一个细胞",
    "你的声音如糖",
    "让我拥有了无尽的力量",
    "每一刻",
    "我都在思念你苏丹III般的容颜",
    "我的思念已进入每一个核苷酸",
    "我的DNA充斥着你的信息",
    "你已控制了我所有的蛋白质",
    "我无法逃避",
    "就算构成细胞膜的磷脂",
    "你也可以轻易穿透",
    "对你的爱在自由扩散",
    "不需要任何的能量和载体",
    "你是细胞核",
    "控制了我的遗传和代谢",
    "你是线粒体",
    "没有你我便失去能量",
    "你是叶绿体",
    "让我拥有了新的养料",
    "你是溶酶体",
    "随时可以溶解我的一切",
    "其实",
    "你就是核糖体",
    "把我像氨基酸一样的俘虏",
    "你就是内质网",
    "把我像蛋白质一样的加工",
    "你就是高尔基体",
    "包裹了我",
    "又把我轻易的放弃",
    "为什么",
    "我还是那么爱你",
    "因为我希望",
    "我们像两个氨基酸一样",
    "脱去那一分子无畏的水",
    "相互连接紧密地肽键",
    "因为我感到",
    "我们像两分子葡萄糖",
    "条件成熟就能合并成麦芽糖",
    "我们就是配对的脱氧核苷酸链",
    "必将形成美丽的双螺旋",
};



//int randint(int p1,int p2)
//{
//    int t;
//    if(p2 > p1)
//    {
//        t = (RNG_Get_RandomNum() % (p2 - p1)) + p1;
//    }
//    else if(p1 > p2)
//    {
//        t = (RNG_Get_RandomNum() % (p1 - p2)) + p2;
//    }
//    else
//    {
//        t = p1;
//    }
//    return t;
//}

//__IO mg_gird MapMain[MG_W][MG_H];

//void Recursive_division(int left, int right, int top, int bottom)
//{
//    int rand_x,rand_y,rand_yt,rand_yb,rand_xl,rand_xr,direct;
//    if ((left < right) && (top < bottom))
//    {
//        rand_x = randint(left, right-1);
//        rand_y = randint(top, bottom-1);
//        rand_yt = randint(top,rand_y);
//        rand_yb = randint(rand_y+1,bottom);
//        rand_xl = randint(left,rand_x);
//        rand_xr = randint(rand_x+1,right);
//        direct = randint(1,4);
//        if (direct == 1)
//        {
//            MapMain[rand_xr][rand_y].msg[2] = 1;
//            MapMain[rand_xr][rand_y+1].msg[0] = 1;
//            MapMain[rand_x][rand_yt].msg[3] = 1;
//            MapMain[rand_x+1][rand_yt].msg[1] = 1;
//            MapMain[rand_x][rand_yb].msg[3] = 1;
//            MapMain[rand_x+1][rand_yb].msg[1] = 1;
//        }
//        else if (direct == 2)
//        {
//            MapMain[rand_xl][rand_y].msg[2] = 1;
//            MapMain[rand_xl][rand_y+1].msg[0] = 1;
//            MapMain[rand_x][rand_yt].msg[3] = 1;
//            MapMain[rand_x+1][rand_yt].msg[1] = 1;
//            MapMain[rand_x][rand_yb].msg[3] = 1;
//            MapMain[rand_x+1][rand_yb].msg[1] = 1;
//        }
//        else if (direct == 3)
//        {
//            MapMain[rand_xl][rand_y].msg[2] = 1;
//            MapMain[rand_xl][rand_y+1].msg[0] = 1;
//            MapMain[rand_xr][rand_y].msg[2] = 1;
//            MapMain[rand_xr][rand_y+1].msg[0] = 1;
//            MapMain[rand_x][rand_yb].msg[3] = 1;
//            MapMain[rand_x+1][rand_yb].msg[1] = 1;
//        }
//        else if (direct == 4)
//        {
//            MapMain[rand_xl][rand_y].msg[2] = 1;
//            MapMain[rand_xl][rand_y+1].msg[0] = 1;
//            MapMain[rand_xr][rand_y].msg[2] = 1;
//            MapMain[rand_xr][rand_y+1].msg[0] = 1;
//            MapMain[rand_x][rand_yt].msg[3] = 1;
//            MapMain[rand_x+1][rand_yt].msg[1] = 1;
//        }
//        Recursive_division(left, rand_x, top, rand_y);
//        Recursive_division(left, rand_x, rand_y+1, bottom);
//        Recursive_division(rand_x+1, right, rand_y+1, bottom);
//        Recursive_division(rand_x+1, right, top, rand_y);
//    }
//    else if(left < right)
//    {
//        rand_x = randint(left, right-1);
//        MapMain[rand_x][top].msg[3] = 1;
//        MapMain[rand_x+1][top].msg[1] = 1;
//        Recursive_division(left, rand_x, top, top);
//        Recursive_division(rand_x+1, right, top, top);
//    }
//    else if(top < bottom)
//    {
//        rand_y = randint(top,bottom-1);
//        MapMain[left][rand_y].msg[2] = 1;
//        MapMain[left][rand_y+1].msg[0] = 1;
//        Recursive_division(left, left, top, rand_y);
//        Recursive_division(left, left, rand_y+1, bottom);
//    }
//}

//void test_mg(uint16_t x,uint16_t y,uint16_t wid,uint16_t size_x,uint16_t size_y)
//{
//    int pppp,jjjj;
//    
//    memset((void *)MapMain,0,sizeof(MapMain));
//    
//    Recursive_division(0,size_y-1,0,size_x-1);
//    MapMain[0][0].msg[0] = 1;
//    MapMain[size_y-1][size_x-1].msg[2] = 1;
//    
//    if(wid<1)wid = 1;
//    
//    int pi_w = 4 * wid;
//    int pi_h = 4 * wid;
//    
//    for(pppp=0;pppp<size_y;pppp++)
//    {
//        for(jjjj=0;jjjj<size_x;jjjj++)
//        {
//            OLED_Fill(jjjj * pi_w + x + 0 * wid,pppp * pi_h + y + 0 * wid,jjjj * pi_w + x + 1 * wid,pppp * pi_h + y + 1 * wid,1);
//            OLED_Fill(jjjj * pi_w + x + 3 * wid,pppp * pi_h + y + 0 * wid,jjjj * pi_w + x + 4 * wid,pppp * pi_h + y + 1 * wid,1);
//            OLED_Fill(jjjj * pi_w + x + 0 * wid,pppp * pi_h + y + 3 * wid,jjjj * pi_w + x + 1 * wid,pppp * pi_h + y + 4 * wid,1);
//            OLED_Fill(jjjj * pi_w + x + 3 * wid,pppp * pi_h + y + 3 * wid,jjjj * pi_w + x + 4 * wid,pppp * pi_h + y + 4 * wid,1);
//            if(MapMain[pppp][jjjj].msg[0] == 0)
//            {
//                OLED_Fill(jjjj * pi_w + x + 0 * wid,pppp * pi_h + y + 1 * wid,jjjj * pi_w + x + 1 * wid,pppp * pi_h + y + 3 * wid,1);
//            }
//            if(MapMain[pppp][jjjj].msg[1] == 0)
//            {
//                OLED_Fill(jjjj * pi_w + x + 1 * wid,pppp * pi_h + y + 0 * wid,jjjj * pi_w + x + 3 * wid,pppp * pi_h + y + 1 * wid,1);
//            }
//            if(MapMain[pppp][jjjj].msg[2] == 0)
//            {
//                OLED_Fill(jjjj * pi_w + x + 3 * wid,pppp * pi_h + y + 1 * wid,jjjj * pi_w + x + 4 * wid,pppp * pi_h + y + 3 * wid,1);
//            }
//            if(MapMain[pppp][jjjj].msg[3] == 0)
//            {
//                OLED_Fill(jjjj * pi_w + x + 1 * wid,pppp * pi_h + y + 3 * wid,jjjj * pi_w + x + 3 * wid,pppp * pi_h + y + 4 * wid,1);
//            }
//        }
//    }
//}
